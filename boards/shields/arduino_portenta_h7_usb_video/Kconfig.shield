## boards/shields/arduino_portenta_h7_usb_video/Kconfig.shield
```kconfig
# Copyright (c) 2025 Arduino SA
# SPDX-License-Identifier: Apache-2.0

config SHIELD_ARDUINO_PORTENTA_H7_USB_VIDEO
	def_bool $(shields_list_contains,arduino_portenta_h7_usb_video)
```
